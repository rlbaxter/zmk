## app/boards/shields/electrolyte/Kconfig.defconfig
```kconfig
# Copyright (c) 2020 The ZMK Contributors
# SPDX-License-Identifier: MIT

if SHIELD_ELECTROLYTE

config ZMK_KEYBOARD_NAME
    default "Electrolyte"

endif
```

## app/boards/shields/yasui/Kconfig.defconfig
```kconfig
# Copyright (c) 2020 The ZMK Contributors
# SPDX-License-Identifier: MIT

if SHIELD_YASUI

config ZMK_KEYBOARD_NAME
    default "Yasui"

endif
```
